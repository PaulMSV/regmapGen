# regs register map
File version: 1.0.0
Address unit: 16 bits
Registers are 32-bit, read-write, reset 0x0 unless marked. A register's access mark holds for its fields unless they carry their own. Offsets are from the block's base; lines under a group give offsets from that group; [hi:lo] are bit positions; {n}, {i} and the like mark numbered series; 'fields as' and 'values as' point back to an identical list; <NAME> marks a mode.

## Memory map
0x00000000 CSR size 0x102

## CSR
Base 0x00000000
0x00 DATA
  [31:0] val — Value of the register
0x04 CTRL reset 0x100 — Control register
  [15:0] val — Value of the register
0x08 STATUS ro
  [7:0] val — Value of the register
0x100 START wo
  [0] val — Value of the register
